## boards/flash-or-trash-v1/Kconfig
```kconfig
config BOARD
    default "flash-or-trash-v1" if BOARD_FLASH-OR-TRASH-V1

config BOARD_FLASH-OR-TRASH-V1
    bool
    default y
    select BOARD_COMMON_NRF52
    select CPU_MODEL_NRF52840XXAA

source "$(RIOTBOARD)/common/nrf52/Kconfig"
```

## boards/rak4631/Kconfig
```kconfig
config BOARD
    default "rak4631" if BOARD_RAK4631

config BOARD_RAK4631
    bool
    default y
    select BOARD_COMMON_NRF52
    select CPU_MODEL_NRF52840XXAA

source "$(RIOTBOARD)/common/nrf52/Kconfig"
```
